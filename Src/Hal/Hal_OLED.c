#include "stm32f10x.h"
#include "hal_oled.h"

static void Hal_OLED_Config(void);

const unsigned char gImage_BMP[ICON_MAX][32] = { 
	{	//ICON_NO_SIM,//No SIM
		0X00,0X00,0X7F,0XE0,0X7F,0XF0,0X60,0X7C,0X68,0X3C,0X64,0X5C,0X62,0X8C,0X61,0X0C,
		0X62,0X8C,0X64,0X4C,0X68,0X2C,0X60,0X0C,0X7F,0XFC,0X7F,0XFC,0X00,0X00,0X00,0X00,
	},
	{	//ICON_SIGNAL_L00,//SIGNAL 0        
		0X00,0X00,0X00,0X00,0X00,0X00,0X00,0X00,0X00,0X00,0X00,0X00,0X00,0X00,0X00,0X00,
		0X00,0X00,0X00,0X00,0X60,0X00,0X60,0X00,0X60,0X00,0X60,0X00,0X00,0X00,0X00,0X00,
	},
	{	//ICON_SIGNAL_L01,//SIGNAL 1        
		0X00,0X00,0X00,0X00,0X00,0X00,0X00,0X00,0X00,0X00,0X00,0X00,0X00,0X00,0X00,0X00,
		0X0C,0X00,0X0C,0X00,0X6C,0X00,0X6C,0X00,0X6C,0X00,0X6C,0X00,0X00,0X00,0X00,0X00,
	},
	{	//ICON_SIGNAL_L02,//SIGNAL 2
		0X00,0X00,0X00,0X00,0X00,0X00,0X00,0X00,0X00,0X00,0X00,0X00,0X01,0X80,0X01,0X80,
		0X0D,0X80,0X0D,0X80,0X6D,0X80,0X6D,0X80,0X6D,0X80,0X6D,0X80,0X00,0X00,0X00,0X00,
	},
	{	//ICON_SIGNAL_L03,//SIGNAL 3        
		0X00,0X00,0X00,0X00,0X00,0X00,0X00,0X00,0X00,0X30,0X00,0X30,0X01,0XB0,0X01,0XB0,
		0X0D,0XB0,0X0D,0XB0,0X6D,0XB0,0X6D,0XB0,0X6D,0XB0,0X6D,0XB0,0X00,0X00,0X00,0X00,
	},
	{	//ICON_SIGNAL_L04,//SIGNAL 4        
		0X00,0X00,0X00,0X00,0X00,0X06,0X00,0X06,0X00,0X36,0X00,0X36,0X01,0XB6,0X01,0XB6,
		0X0D,0XB6,0X0D,0XB6,0X6D,0XB6,0X6D,0XB6,0X6D,0XB6,0X6D,0XB6,0X00,0X00,0X00,0X00,
	},
	{	//ICON_ONENET_STA_BREAK, 
		0X00,0X70,0X00,0XD8,0X01,0X8C,0X19,0X06,0X1C,0X03,0X0E,0X01,0X07,0X03,0X33,0X86,
		0X61,0XCC,0XC0,0XE0,0X80,0X70,0XC0,0X38,0X60,0X98,0X31,0X80,0X1B,0X00,0X0E,0X00,
	},
	{	//ICON_ONENET_STA_LINK,  
		0X00,0X70,0X00,0XD8,0X01,0X8C,0X03,0X06,0X02,0X03,0X01,0X61,0X18,0XE3,0X35,0XC6,
		0X63,0XAC,0XC7,0X18,0X86,0X80,0XC0,0X40,0X60,0XC0,0X31,0X80,0X1B,0X00,0X0E,0X00,
	}
};

/*----------------------------------------------------------------------------
@Name		: Hal_OLED_Config()
@Function	: OELD GPIO config
@Parameter	: Null
------------------------------------------------------------------------------*/
static void Hal_OLED_Config(void)
{
	SPI_InitTypeDef  SPI_InitStructure;
	GPIO_InitTypeDef GPIO_InitStructure;
	
	/* Enable SPI1 and GPIOA clocks */
	RCC_APB2PeriphClockCmd(RCC_APB2Periph_SPI1, ENABLE);
	RCC_APB2PeriphClockCmd(RCC_APB2Periph_GPIOA, ENABLE);	
	RCC_APB2PeriphClockCmd(RCC_APB2Periph_AFIO, ENABLE);
	
	/* Configure SPI1 pins: SCK, MOSI */
	GPIO_InitStructure.GPIO_Pin =  GPIO_Pin_5 |GPIO_Pin_7;
	GPIO_InitStructure.GPIO_Speed = GPIO_Speed_50MHz;
	GPIO_InitStructure.GPIO_Mode = GPIO_Mode_AF_PP;
	GPIO_Init(GPIOA, &GPIO_InitStructure);
	
	//OLED RST
	GPIO_InitStructure.GPIO_Pin = GPIO_Pin_4;
	GPIO_InitStructure.GPIO_Speed = GPIO_Speed_50MHz;
	GPIO_InitStructure.GPIO_Mode = GPIO_Mode_Out_PP;
	GPIO_Init(GPIOA, &GPIO_InitStructure);
	GPIO_SetBits(GPIOA,GPIO_Pin_4);
	
	//OLED CMD/DATA
	GPIO_InitStructure.GPIO_Pin = GPIO_Pin_6;
	GPIO_InitStructure.GPIO_Speed = GPIO_Speed_50MHz;
	GPIO_InitStructure.GPIO_Mode = GPIO_Mode_Out_PP;
	GPIO_Init(GPIOA, &GPIO_InitStructure);
	GPIO_SetBits(GPIOA,GPIO_Pin_6);
	
	/* SPI1 configuration */ 
	SPI_InitStructure.SPI_Direction = SPI_Direction_1Line_Tx; 			 
	SPI_InitStructure.SPI_Mode = SPI_Mode_Master;	                    
	SPI_InitStructure.SPI_DataSize = SPI_DataSize_8b;                 
	SPI_InitStructure.SPI_CPOL = SPI_CPOL_High;	 		             
	SPI_InitStructure.SPI_CPHA = SPI_CPHA_2Edge;		             
	SPI_InitStructure.SPI_NSS = SPI_NSS_Soft;			                
	SPI_InitStructure.SPI_BaudRatePrescaler = SPI_BaudRatePrescaler_8; 	
	SPI_InitStructure.SPI_FirstBit = SPI_FirstBit_MSB;				    
	SPI_InitStructure.SPI_CRCPolynomial = 7;						     
	SPI_Init(SPI1, &SPI_InitStructure);
	/* Enable SPI1  */
	SPI_Cmd(SPI1, ENABLE); 											  	 
}


const unsigned char asc2_0806[][6] =
{
{0x00, 0x00, 0x00, 0x00, 0x00, 0x00},// sp
{0x00, 0x00, 0x00, 0x2f, 0x00, 0x00},// !
{0x00, 0x00, 0x07, 0x00, 0x07, 0x00},// "
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{0x14, 0x14, 0x14, 0x14, 0x14, 0x14},// horiz lines
};
//12*12 ASCII
const unsigned char asc2_1206[95][12]={
{0x00,0x00,0x00,0x00,0x00,0x00,0x00,0x00,0x00,0x00,0x00,0x00},/*" ",0*/
{0x00,0x00,0xFC,0x00,0x00,0x00,0x00,0x00,0x02,0x00,0x00,0x00},/*"!",1*/
{0x00,0x0C,0x02,0x0C,0x02,0x00,0x00,0x00,0x00,0x00,0x00,0x00},/*""",2*/
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{0x02,0x01,0x02,0x04,0x04,0x02,0x00,0x00,0x00,0x00,0x00,0x00},/*"~",94*/
};  
//16*16 ASCII
const unsigned char asc2_1608[][16]={	  
{0x00,0x00,0x00,0x00,0x00,0x00,0x00,0x00,0x00,0x00,0x00,0x00,0x00,0x00,0x00,0x00},/*" ",0*/
{0x00,0x00,0x00,0xF8,0x00,0x00,0x00,0x00,0x00,0x00,0x00,0x33,0x30,0x00,0x00,0x00},/*"!",1*/
{0x00,0x10,0x0C,0x06,0x10,0x0C,0x06,0x00,0x00,0x00,0x00,0x00,0x00,0x00,0x00,0x00},/*""",2*/
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{0x00,0x06,0x01,0x01,0x02,0x02,0x04,0x04,0x00,0x00,0x00,0x00,0x00,0x00,0x00,0x00},/*"~",94*/
};  
//24*24 ASICII
const unsigned char asc2_2412[][36]={	  
{0x00,0x00,0x00,0x00,0x00,0x00,0x00,0x00,0x00,0x00,0x00,0x00,0x00,0x00,0x00,0x00,0x00,0x00,0x00,0x00,0x00,0x00,0x00,0x00,0x00,0x00,0x00,0x00,0x00,0x00,0x00,0x00,0x00,0x00,0x00,0x00},/*" ",0*/
{0x00,0x00,0x00,0x00,0x00,0xF0,0xF0,0xF0,0x00,0x00,0x00,0x00,0x00,0x00,0x00,0x00,0x00,0x01,0x7F,0x01,0x00,0x00,0x00,0x00,0x00,0x00,0x00,0x00,0x00,0x1C,0x1C,0x1C,0x00,0x00,0x00,0x00},/*"!",1*/
{0x00,0x00,0x80,0x60,0x30,0x1C,0x8C,0x60,0x30,0x1C,0x0C,0x00,0x00,0x00,0x00,0x00,0x00,0x00,0x00,0x00,0x00,0x00,0x00,0x00,0x00,0x00,0x00,0x00,0x00,0x00,0x00,0x00,0x00,0x00,0x00,0x00},/*""",2*/
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{0x00,0x18,0x06,0x02,0x02,0x04,0x08,0x10,0x20,0x20,0x30,0x08,0x00,0x00,0x00,0x00,0x00,0x00,0x00,0x00,0x00,0x00,0x00,0x00,0x00,0x00,0x00,0x00,0x00,0x00,0x00,0x00,0x00,0x00,0x00,0x00},/*"~",94*/



};

 
				 

static void hal_Oled_Delay(unsigned short t);
//static void hal_OledConfig(void);
static void hal_Oled_DrawPoint(unsigned char x,unsigned char y,unsigned char t);
static unsigned int hal_Oled_pow(unsigned char m,unsigned char n);
//static void hal_Oled_WR_Byte(unsigned char dat,unsigned char cmd);
static void hal_Oled_WR_Byte(unsigned char dat,unsigned char cmd);
//static unsigned char  hal_spiReadWriteByte(unsigned char  TxData);

u8 OLED_GRAM[128][8];


// reverse display mode, 0:normal, 1:reverse
void hal_Oled_Color_Turn(unsigned char i)
{
	if(i==0)
		{
			hal_Oled_WR_Byte(0xA6,OLED_CMD);	// normal
		}
	if(i==1)
		{
			hal_Oled_WR_Byte(0xA7,OLED_CMD);	// reverse
		}
}


void hal_Oled_Display_Turn(unsigned char i)
{
	if(i==0)
		{
			hal_Oled_WR_Byte(0xC8,OLED_CMD);
			hal_Oled_WR_Byte(0xA1,OLED_CMD);
		}
	if(i==1)
		{
			hal_Oled_WR_Byte(0xC0,OLED_CMD);
			hal_Oled_WR_Byte(0xA0,OLED_CMD);
		}
}

static void hal_Oled_WR_Byte(unsigned char dat,unsigned char cmd)
{		
	unsigned char retry=0;		
	if(cmd)
	{
		OLED_DC_Set();
	}else 
	{
		OLED_DC_Clr();		  
	}
	 
	SPI1->DR=dat;	 	  
			 
	retry=0;
 
	while((SPI1->SR & SPI_I2S_FLAG_BSY) != RESET)
	{
		retry++;
		if(retry>200)
			return;
	}	  						    
 		 		  
	OLED_DC_Set();   	  
}


void hal_Oled_Display_on(void)
{
	hal_Oled_WR_Byte(0x8D,OLED_CMD);
	hal_Oled_WR_Byte(0x14,OLED_CMD);
	hal_Oled_WR_Byte(0xAF,OLED_CMD);
}


void hal_Oled_Display_Off(void)
{
	hal_Oled_WR_Byte(0x8D,OLED_CMD);
	hal_Oled_WR_Byte(0x10,OLED_CMD);
	hal_Oled_WR_Byte(0xAE,OLED_CMD);
}


void hal_Oled_Refresh(void)
{
	unsigned char i,n;
	for(i=0;i<8;i++)
	{
	   hal_Oled_WR_Byte(0xb0+i,OLED_CMD); // set startubg address
	   hal_Oled_WR_Byte(0x00,OLED_CMD);   // set low column start address
	   hal_Oled_WR_Byte(0x10,OLED_CMD);   // set high column start address
	   for(n=0;n<128;n++)
		 hal_Oled_WR_Byte(OLED_GRAM[n][i],OLED_DATA);
  }
}

void hal_Oled_Clear(void)
{
	unsigned char i,n;
	for(i=0;i<8;i++)
	{
	   for(n=0;n<128;n++)
		{
		 OLED_GRAM[n][i]=0;
		}
	}
	hal_Oled_Refresh();
}


//x:0~127
//y:0~63
//t:1->fill 0->clear	
static void hal_Oled_DrawPoint(unsigned char x,unsigned char y,unsigned char t)
{
	unsigned char i,m,n;
	i=y/8;
	m=y%8;
	n=1<<m;
	if(t){OLED_GRAM[x][i]|=n;}
	else
	{
		OLED_GRAM[x][i]=~OLED_GRAM[x][i];
		OLED_GRAM[x][i]|=n;
		OLED_GRAM[x][i]=~OLED_GRAM[x][i];
	}
}


//x1,y1: start coordinate
//x2,y2: end coordinate
void hal_Oled_DrawLine(unsigned char x1,unsigned char y1,unsigned char x2,unsigned char y2,unsigned char mode)
{
	unsigned short t; 
	int xerr=0,yerr=0,delta_x,delta_y,distance;
	int incx,incy,uRow,uCol;
	delta_x=x2-x1; 
	delta_y=y2-y1;
	uRow=x1;
	uCol=y1;
	if(delta_x>0)
	{
		incx=1; 
	}else if(delta_x==0)
	{
		incx=0;
	}else 
	{
		incx=-1;
		delta_x=-delta_x;
	}
	if(delta_y>0)
	{
		incy=1;
	}else if(delta_y==0)
	{
		incy=0;
	}else 
	{
		incy=-1;
		delta_y=-delta_x;
	}
	if(delta_x>delta_y)
	{
		distance=delta_x; 
	}else 
	{
		distance=delta_y;
	}
	for(t=0;t<distance+1;t++)
	{
		hal_Oled_DrawPoint(uRow,uCol,mode);
		xerr+=delta_x;
		yerr+=delta_y;
		if(xerr>distance)
		{
			xerr-=distance;
			uRow+=incx;
		}
		if(yerr>distance)
		{
			yerr-=distance;
			uCol+=incy;
		}
	}
}

//x,y: circle center coor
//r: radius
void hal_Oled_DrawCircle(unsigned char x,unsigned char y,unsigned char r)
{
	int a, b,num;
    a = 0;
    b = r;
    while(2 * b * b >= r * r)      
    {
        hal_Oled_DrawPoint(x + a, y - b,1);
        hal_Oled_DrawPoint(x - a, y - b,1);
        hal_Oled_DrawPoint(x - a, y + b,1);
        hal_Oled_DrawPoint(x + a, y + b,1);
 
        hal_Oled_DrawPoint(x + b, y + a,1);
        hal_Oled_DrawPoint(x + b, y - a,1);
        hal_Oled_DrawPoint(x - b, y - a,1);
        hal_Oled_DrawPoint(x - b, y + a,1);
        
        a++;
        num = (a * a + b * b) - r*r;
        if(num > 0)
        {
            b--;
            a--;
        }
    }
}




//x:0~127
//y:0~63
//size1:font 6x8/6x12/8x16/12x24
//mode:0->reverse display; 1->normal display
void hal_Oled_ShowChar(unsigned char x,unsigned char y,unsigned char chr,unsigned char size1,unsigned char mode)
{
	unsigned char i,m,temp,size2,chr1;
	unsigned char x0=x,y0=y;
	if(size1==8)
	{
		size2=6;
	}else 
	{
		size2=(size1/8+((size1%8)?1:0))*(size1/2);  
	}
	chr1=chr-' '; 
	for(i=0;i<size2;i++)
	{
		if(size1==8)
		{
			temp=asc2_0806[chr1][i];	// 0806
		}else if(size1==12)
        {
			temp=asc2_1206[chr1][i];	// 1206
		}else if(size1==16)
        {
			temp=asc2_1608[chr1][i];	// 1608
		}else if(size1==24)
        { 
			temp=asc2_2412[chr1][i];	// 2412
		} 
		else 
		{
			return;
		}
		for(m=0;m<8;m++)
		{
			if(temp&0x01)
			{
				hal_Oled_DrawPoint(x,y,mode);
			}else 
			{
				hal_Oled_DrawPoint(x,y,!mode);
			}
			temp>>=1;
			y++;	
		
		}
		x++;		
		if((size1!=8)&&((x-x0)==size1/2))	
		{
			x=x0;y0=y0+8;
		}
		y=y0;
  }
}


//x,y:   starting coordinate 
//size1: font size
//*chr:  string address 
//mode:  0->reverse display; 1->normal display
void hal_Oled_ShowString(unsigned char x,unsigned char y,unsigned char *chr,unsigned char size1,unsigned char mode)
{
	while((*chr>=' ')&&(*chr<='~'))	// invalid char
	{
		hal_Oled_ShowChar(x,y,*chr,size1,mode);
		if(size1==8)
		{
			x+=6;
		}
		else 
		{	
			x+=size1/2;
		}
		chr++;
  }
}

//m^n
static unsigned int hal_Oled_pow(unsigned char m,unsigned char n)
{
	unsigned int result=1;
	while(n--)
	{
	  result*=m;
	}
	return result;
}


//x,y : starting coordinate
//num : number
//len : length of number
//size: font size
//mode:	0->reverse display; 1->normal display
void hal_Oled_ShowNum(unsigned char x,unsigned char y,unsigned int num,unsigned char len,unsigned char size1,unsigned char mode)
{
	unsigned char t,temp,m=0;
	if(size1==8)
	{
		m=2;
	}
	for(t=0;t<len;t++)
	{
		temp=(num/hal_Oled_pow(10,len-t-1))%10;
		if(temp==0)
		{
			hal_Oled_ShowChar(x+(size1/2+m)*t,y,'0',size1,mode);
		}else 
		{
		  hal_Oled_ShowChar(x+(size1/2+m)*t,y,temp+'0',size1,mode);
		}
  }
}



// x, y: starting coordinate
// sizex, sizey: picture size
// BMP[]: bitmap array
// mode: 0->reverse display; 1->normal display
void hal_Oled_ShowPicture(unsigned char x, unsigned char y, unsigned char sizex, unsigned char sizey, const unsigned char BMP[], unsigned char mode)
{
    unsigned short j = 0;        	
    unsigned char i, n, temp, m; 	
    unsigned char x0 = x; 			
        
    sizex = sizex / 8; 	
        
    for (n = 0; n < sizey; n++)
    {
        for (i = 0; i < sizex; i++)
        {
            temp = BMP[j]; 
            j++; 			

            for (m = 0; m < 8; m++)
            {
                if (temp & 0x80) 
                {
                    hal_Oled_DrawPoint(x, y, mode); 
                } 
                else 
                {
                    hal_Oled_DrawPoint(x, y, !mode); 
                }
                temp <<= 1; 	
                x++; 			
            }
        }

        x = x0; 	
        y = y + 1; 	
    }
}


//**************************************************************
//@Name: hal_Oled_icon(unsigned char loc, unsigned char fuc)
//@function：display icon
//@Parameters：    
//		--> loc:  0  SIM Card condition ,    1  server connection status  
//      --> fuc:  icon to display 
//**************************************************************
void hal_Oled_inco(unsigned char loc, unsigned char fuc)
{
    switch(loc)
    {
        case 0: 
		{
			hal_Oled_ShowPicture(110, 0, 16, 16, gImage_BMP[fuc], 1); 
            hal_Oled_Refresh(); 
		}  
        break;
       
        case 1: 
		{
			hal_Oled_ShowPicture(92, 0, 16, 16, gImage_BMP[fuc], 1); 
            hal_Oled_Refresh(); 
		}    
        break;    
    }
}


//x,y：starting coordinate
//sizex,sizey
void hal_Oled_ClearArea(unsigned char x,unsigned char y,unsigned char sizex,unsigned char sizey)
{
	unsigned char i,n,m;
	unsigned char xy=0;
	unsigned char y1;
 
	y1 = y;
	xy=sizey/8;
	 
	for(n=0;n<xy;n++)
	{
		for(i=0; i<sizex; i++)
		{
			for(m=0; m<8; m++)
			{
				hal_Oled_DrawPoint(x+i,y1+m,0);
			}
		}
		y1 = y1+8;
	}
	
	xy=sizey%8;
	for(i=0; i<sizex; i++)
	{
		for(m=0; m<xy; m++)
		{
			hal_Oled_DrawPoint(x+i,y1+m,0);
		}
	}
	
	
}
 
static void hal_Oled_Delay(unsigned short t)
{
	unsigned short i,j,k;
	j = t;
	for(i=0; i<j; i++)
	{
		for(k=0; k<1000; k++);
	}
}


void hal_OledInit(void)
{
	Hal_OLED_Config();
	
	OLED_RES_Clr();
	hal_Oled_Delay(20);
	OLED_RES_Set();
	
	hal_Oled_WR_Byte(0xAE,OLED_CMD);//--turn off oled panel
	hal_Oled_WR_Byte(0x00,OLED_CMD);//---set low column address
	hal_Oled_WR_Byte(0x10,OLED_CMD);//---set high column address
	hal_Oled_WR_Byte(0x40,OLED_CMD);//--set start line address  Set Mapping RAM Display Start Line (0x00~0x3F)
	hal_Oled_WR_Byte(0x81,OLED_CMD);//--set contrast control register
	hal_Oled_WR_Byte(0xCF,OLED_CMD);// Set SEG Output Current Brightness
	hal_Oled_WR_Byte(0xA1,OLED_CMD);//--Set SEG/Column Mapping     0xa0 left right reverse, 0xa1 normal
	hal_Oled_WR_Byte(0xC8,OLED_CMD);//Set COM/Row Scan Direction   0xc0 up down reversem,   0xc8 normal
	hal_Oled_WR_Byte(0xA6,OLED_CMD);//--set normal display
	hal_Oled_WR_Byte(0xA8,OLED_CMD);//--set multiplex ratio(1 to 64)
	hal_Oled_WR_Byte(0x3f,OLED_CMD);//--1/64 duty
	hal_Oled_WR_Byte(0xD3,OLED_CMD);//-set display offset	Shift Mapping RAM Counter (0x00~0x3F)
	hal_Oled_WR_Byte(0x00,OLED_CMD);//-not offset
	hal_Oled_WR_Byte(0xd5,OLED_CMD);//--set display clock divide ratio/oscillator frequency
	hal_Oled_WR_Byte(0x80,OLED_CMD);//--set divide ratio, Set Clock as 100 Frames/Sec
	hal_Oled_WR_Byte(0xD9,OLED_CMD);//--set pre-charge period
	hal_Oled_WR_Byte(0xF1,OLED_CMD);//Set Pre-Charge as 15 Clocks & Discharge as 1 Clock
	hal_Oled_WR_Byte(0xDA,OLED_CMD);//--set com pins hardware configuration
	hal_Oled_WR_Byte(0x12,OLED_CMD);
	hal_Oled_WR_Byte(0xDB,OLED_CMD);//--set vcomh
	hal_Oled_WR_Byte(0x40,OLED_CMD);//Set VCOM Deselect Level
	hal_Oled_WR_Byte(0x20,OLED_CMD);//-Set Page Addressing Mode (0x00/0x01/0x02)
	hal_Oled_WR_Byte(0x02,OLED_CMD);//
	hal_Oled_WR_Byte(0x8D,OLED_CMD);//--set Charge Pump enable/disable
	hal_Oled_WR_Byte(0x14,OLED_CMD);//--set(0x10) disable
	hal_Oled_WR_Byte(0xA4,OLED_CMD);// Disable Entire Display On (0xa4/0xa5)
	hal_Oled_WR_Byte(0xA6,OLED_CMD);// Disable Inverse Display On (0xa6/a7) 
	hal_Oled_Clear();
	hal_Oled_WR_Byte(0xAF,OLED_CMD);
	
}
